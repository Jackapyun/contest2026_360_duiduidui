## board/contest_board/k1-rcpu/boards/k1-rcpu/muse_pi_pro_rcpu/configs/nsh-min/defconfig
```kconfig
# SpaceMiT MUSE Pi Pro - RCPU (N308) NSH 最小体积版
# 基线: configs/nsh/defconfig（全功能验证版 206KB）
# 目标: 固件 < 256KB 且堆余量 > 100KB（256KB SRAM 硬预算）
# 裁剪:
#   - 移除测试组件 ostest/mm/getprime/hello
#   - 关闭断言/backtrace/栈染色/dumpstack/调试日志字符串
#   - 关闭 libm 与 strerror 全表
#   - 关闭 builtin/符号表/readline 历史
#   - 禁用部分 NSH 命令
# 保留: DEBUG_FULLOPT(-Os)、procfs（调试价值高）、FPU
CONFIG_ARCH="risc-v"
CONFIG_ARCH_RISCV=y
CONFIG_ARCH_CHIP="k1-rcpu"
CONFIG_ARCH_CHIP_K1_RCPU=y
CONFIG_ARCH_CHIP_RISCV_CUSTOM=y
CONFIG_ARCH_CHIP_CUSTOM=y
CONFIG_ARCH_CHIP_CUSTOM_DIR="../vendor/SpaceMiT/chips/k1-rcpu"
CONFIG_ARCH_CHIP_CUSTOM_DIR_RELPATH=y
CONFIG_ARCH_CHIP_CUSTOM_NAME="k1-rcpu"
CONFIG_ARCH_BOARD="muse_pi_pro_rcpu"
CONFIG_ARCH_BOARD_CUSTOM=y
CONFIG_ARCH_BOARD_CUSTOM_DIR="../vendor/SpaceMiT/boards/k1-rcpu/muse_pi_pro_rcpu"
CONFIG_ARCH_BOARD_CUSTOM_DIR_RELPATH=y
CONFIG_ARCH_BOARD_CUSTOM_NAME="muse_pi_pro_rcpu"
CONFIG_ARCH_BOARD_MUSE_PI_PRO_RCPU=y
CONFIG_ARCH_INTERRUPTSTACK=2048
CONFIG_ARCH_STACKDUMP=y
CONFIG_DEBUG_FEATURES=y
CONFIG_DEBUG_FULLOPT=y
CONFIG_DEBUG_SYMBOLS=y
CONFIG_DEBUG_SYMBOLS_LEVEL="-g"
CONFIG_BOARD_LOOPSPERMSEC=131
CONFIG_DEV_ZERO=y
CONFIG_DEV_NULL=y
CONFIG_FILE_STREAM=y
CONFIG_FS_PROCFS=y
CONFIG_IDLETHREAD_STACKSIZE=2048
CONFIG_INIT_ENTRYPOINT="nsh_main"
CONFIG_INIT_STACKSIZE=3072
CONFIG_LIBC_ENVPATH=y
CONFIG_LIBC_PERROR_STDOUT=y
CONFIG_NFILE_DESCRIPTORS_PER_BLOCK=6
CONFIG_NSH_ARCHINIT=y
CONFIG_NSH_FILEIOSIZE=512
CONFIG_NSH_READLINE=y
CONFIG_RAM_SIZE=262144
CONFIG_RAM_START=0x0
CONFIG_RAW_BINARY=y
CONFIG_RR_INTERVAL=200
CONFIG_SCHED_WAITPID=y
CONFIG_SERIAL_UART_ARCH_MMIO=y
CONFIG_START_DAY=13
CONFIG_START_MONTH=8
CONFIG_START_YEAR=2026
CONFIG_SYSTEM_NSH=y
CONFIG_SYSTEM_NSH_STACKSIZE=3072
CONFIG_USEC_PER_TICK=1000
# RCPU UART0: PXA variant (ns16550 + UUE) @0xC0881000, ECLIC ID 63 -> IRQ 79
CONFIG_16550_ADDRWIDTH=0
CONFIG_16550_REGINCR=4
CONFIG_16550_UART=y
CONFIG_16550_UART0=y
CONFIG_16550_UART0_BASE=0xc0881000
CONFIG_16550_UART0_CLOCK=25600000
CONFIG_16550_UART0_IRQ=79
CONFIG_16550_UART0_SERIAL_CONSOLE=y
# ---- 裁剪：测试组件 / 调试 / libm / builtin / 命令 ----
# CONFIG_TESTING_OSTEST is not set
# CONFIG_TESTING_MM is not set
# CONFIG_TESTING_GETPRIME is not set
# CONFIG_EXAMPLES_HELLO is not set
# CONFIG_DEBUG_ASSERTIONS is not set
# CONFIG_DEBUG_ERROR is not set
# CONFIG_DEBUG_WARN is not set
# CONFIG_DEBUG_INFO is not set
# CONFIG_SCHED_BACKTRACE is not set
# CONFIG_STACK_COLORATION is not set
# CONFIG_SYSTEM_DUMPSTACK is not set
# CONFIG_SYSLOG_COLOR_OUTPUT is not set
# CONFIG_LIBM is not set
# CONFIG_LIBC_STRERROR is not set
# CONFIG_BUILTIN is not set
# CONFIG_NSH_BUILTIN_APPS is not set
# CONFIG_SYMTAB_ORDEREDBYNAME is not set
# CONFIG_READLINE_CMD_HISTORY is not set
# CONFIG_NSH_DISABLE_DD is not set
# CONFIG_NSH_DISABLE_LOSETUP is not set
# CONFIG_NSH_DISABLE_HEXDUMP is not set
# CONFIG_NSH_DISABLE_DMESG is not set
# CONFIG_NSH_DISABLE_KILL is not set
# CONFIG_NSH_DISABLE_EXEC is not set
# CONFIG_NSH_DISABLE_GET is not set
# CONFIG_NSH_DISABLE_LOSMART is not set
# CONFIG_NSH_DISABLE_LOMTD is not set
```

## board/contest_board/k1-rcpu/chips/k1-rcpu/Kconfig
```kconfig
#
# For a description of the syntax of this configuration file,
# see the file kconfig-language.txt in the NuttX tools repository.
#

if ARCH_CHIP_CUSTOM

comment "SpaceMiT RCPU (N308) Configuration Options"

choice
	prompt "SpaceMiT RCPU Chip Selection"
	default ARCH_CHIP_K1_RCPU

config ARCH_CHIP_K1_RCPU
	bool "SpacemiT K1 RCPU (Nuclei N308, RV32)"
	select ARCH_RV32
	select ARCH_RV_ISA_M
	select ARCH_RV_ISA_A
	select ARCH_RV_ISA_C
	select ARCH_RV_ISA_ZICSR_ZIFENCEI
	select ARCH_HAVE_FPU
	select ARCH_HAVE_DPFPU
	select ARCH_HAVE_MPU
	select ONESHOT
	select ONESHOT_COUNT
	select ALARM_ARCH
	---help---
		SpacemiT K1 实时协处理器：Nuclei N308（RV32IMAFDCPB、3 级流水、
		无 MMU、16KB D-Cache、8 条 PMP、ECLIC 中断、64 位私有 TIMER，
		主频 245MHz）。固件由 AP 侧 remoteproc 加载（官方 esOS 入口
		0x30300114）或 JTAG 加载；本移植目标为 32 位 M-Mode 单核 FLAT。
		全部代码在本 vendor 目录管理，不新建 arch/risc-v/src 子目录。

endchoice

if ARCH_CHIP_K1_RCPU

config K1R_UART
	bool "K1 RCPU SHUB_UART 串口驱动"
	default y
	---help---
		SpaceMiT K1 RCPU SHUB_UART（PXA/Intel XScale 变体）专用串口
		驱动。PXA 与标准 ns16550 的语义不同：RDA 中断硬件上依赖
		IER.RTOIE、RTO（接收超时）需独立处理、需设 FCR.BUS32、
		TX 中断为 FIFO 半空触发。标准 ns16550 驱动不适配（GDB 实测
		仅使能 RAVIE 时 RX 中断不上报）。

if K1R_UART

config K1R_UART0_BAUD
	int "UART0 波特率"
	default 115200

config K1R_UART0_CLOCK
	int "UART0 输入时钟 (Hz)"
	default 24000000

config K1R_UART0_SERIAL_CONSOLE
	bool "UART0 作为串口控制台"
	default y

endif # K1R_UART

endif # ARCH_CHIP_K1_RCPU

endif
```
